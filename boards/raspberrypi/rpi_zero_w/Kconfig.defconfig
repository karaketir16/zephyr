## boards/raspberrypi/rpi_zero_w/Kconfig.defconfig
```kconfig
# SPDX-License-Identifier: Apache-2.0

if BOARD_RPI_ZERO_W

if WIFI_AIROC

config MAIN_STACK_SIZE
	default 4096

config HEAP_MEM_POOL_ADD_SIZE_BOARD
	int
	default 65536

endif # WIFI_AIROC

endif # BOARD_RPI_ZERO_W
```

## boards/raspberrypi/rpi_zero_w/rpi_zero_w_defconfig
```kconfig
# SPDX-License-Identifier: Apache-2.0

CONFIG_XIP=n
CONFIG_FLASH_SIZE=0
CONFIG_FLASH_BASE_ADDRESS=0x0

CONFIG_SERIAL=y
CONFIG_CONSOLE=y
CONFIG_UART_CONSOLE=y
CONFIG_TICKLESS_KERNEL=n
CONFIG_ARM_AARCH32_MMU=y
```

## drivers/sdhc/Kconfig.bcm2835
```kconfig
# Copyright (c) 2026
# SPDX-License-Identifier: Apache-2.0

config SDHC_BCM2835
	bool "BCM2835 SDHCI host controller"
	depends on SOC_BCM2835
	default y if DT_HAS_BRCM_BCM2835_SDHCI_ENABLED
	select SDHC_SUPPORTS_NATIVE_MODE
	help
	  Enable the BCM2835 SDHCI/eMMC host controller. On Raspberry Pi
	  Zero W this controller is wired to the on-board CYW43438 Wi-Fi
	  device over SDIO.
```

## dts/bindings/sdhc/brcm,bcm2835-sdhci.yaml
```yaml
# Copyright (c) 2026
# SPDX-License-Identifier: Apache-2.0

description: Broadcom BCM2835 SDHCI/eMMC host controller

compatible: "brcm,bcm2835-sdhci"

include: [sdhc.yaml, pinctrl-device.yaml]

properties:
  reg:
    required: true

  interrupts:
    required: true

  clock-frequency:
    type: int
    required: true
    description: Input clock frequency for the controller.

  bus-width:
    type: int
    default: 1
    enum:
      - 1
      - 4

  reset-gpios:
    type: phandle-array
    description: Optional active-low reset GPIO for a non-removable SDIO device.
```

## samples/net/wifi/shell/boards/rpi_zero_w.conf
```kconfig
CONFIG_WIFI_AIROC=y
CONFIG_CYW43438=y
CONFIG_CYW43438_RPI_ZERO_W=y

CONFIG_WIFI_LOG_LEVEL_DBG=y
CONFIG_LOG_MODE_IMMEDIATE=y
CONFIG_LOG_BACKEND_UART=y
CONFIG_SHELL_BACKEND_SERIAL_API_POLLING=y

CONFIG_MAIN_STACK_SIZE=8192
CONFIG_SHELL_STACK_SIZE=8192
CONFIG_SYSTEM_WORKQUEUE_STACK_SIZE=4096
CONFIG_NET_MGMT_EVENT_STACK_SIZE=4096
CONFIG_AIROC_WIFI_EVENT_TASK_STACK_SIZE=4096
CONFIG_HEAP_MEM_POOL_SIZE=65536

CONFIG_NET_BUF_RX_COUNT=32
CONFIG_NET_BUF_TX_COUNT=32
CONFIG_NET_PKT_RX_COUNT=24
CONFIG_NET_PKT_TX_COUNT=24
CONFIG_NET_BUF_DATA_SIZE=1600
```

## samples/subsys/logging/logger/boards/rpi_zero_w_debug.conf
```kconfig
CONFIG_ASSERT=y
CONFIG_EXCEPTION_DEBUG=y
CONFIG_EXTRA_EXCEPTION_INFO=y
CONFIG_SIMPLIFIED_EXCEPTION_CODES=n
CONFIG_FAULT_DUMP=2
CONFIG_INIT_STACKS=y
CONFIG_THREAD_MONITOR=y
CONFIG_STACK_SENTINEL=y
CONFIG_LOG_MODE_DEFERRED=n
CONFIG_LOG_MODE_IMMEDIATE=y
CONFIG_LOG_PRINTK=n
CONFIG_LOG_BACKEND_SHOW_COLOR=n
```

## soc/brcm/bcm2835/Kconfig.defconfig
```kconfig
# SPDX-License-Identifier: Apache-2.0

if SOC_BCM2835

config NUM_IRQS
	default 72

config SYS_CLOCK_HW_CYCLES_PER_SEC
	default 1000000

endif
```

## tests/boards/raspberrypi/rpi_zero_w/sdhci_sdio/testcase.yaml
```yaml
# SPDX-License-Identifier: Apache-2.0

common:
  tags:
    - sdhc
    - sdio
tests:
  boards.rpi_zero_w.sdhci_sdio:
    harness: ztest
    platform_allow:
      - rpi_zero_w/bcm2835
    build_only: true
```
